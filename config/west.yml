## config/west.yml
```yaml
manifest:
  remotes:
    - name: zmkfirmware
      url-base: https://github.com/zmkfirmware
    - name: hyhy-masa
      url-base: https://github.com/hyhy-masa
    - name: caksoylar  # <-- new entry
      url-base: https://github.com/caksoylar  
  projects:
    - name: zmk
      remote: hyhy-masa
      revision: 2e2e8e8c
      import: app/west.yml
    - name: pmw3610-driver-minimal
      remote: hyhy-masa
      revision: "aae0701"
      path: modules/pmw3610-driver-minimal
    - name: zmk-rgbled-widget
      remote: caksoylar
      revision: e9472d6c
    - name: zmk-module-ble-management
      remote: hyhy-masa
      revision: 851661cd
    - name: zmk-module-settings-rpc
      remote: hyhy-masa
      revision: ad1c995c
  self:
    path: config
```
